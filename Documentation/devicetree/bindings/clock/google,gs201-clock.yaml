## Documentation/devicetree/bindings/power/google,gs201-power-domain.yaml
```yaml
# SPDX-License-Identifier: GPL-2.0-only OR BSD-2-Clause
%YAML 1.2
---
$id: http://devicetree.org/schemas/power/google,gs201-power-domain.yaml#
$schema: http://devicetree.org/meta-schemas/core.yaml#

title: Google GS201 PMU power domains

maintainers:
  - Theo Paris <theo@theoparis.com>

description: |
  Power domains of the Google Tensor G2 controlled through the PMU. Each
  domain has a CONFIGURATION register in the PMU (bit 0 powers the domain)
  followed by a STATUS register. A domain may be a child of another one.

allOf:
  - $ref: power-domain.yaml#

properties:
  compatible:
    const: google,gs201-power-domain

  reg:
    maxItems: 1
    description:
      The CONTROLLER_OPTION register of the domain's CMU. Bit 24 is cleared
      before the domain is powered down. Omit if the domain has none.

  "#power-domain-cells":
    const: 0

  power-domains:
    maxItems: 1
    description: Parent domain.

  google,pmu-syscon:
    $ref: /schemas/types.yaml#/definitions/phandle
    description: The PMU syscon.

  google,pmu-offset:
    $ref: /schemas/types.yaml#/definitions/uint32
    description:
      Offset of the domain's CONFIGURATION register in the PMU; the STATUS
      register follows at +4.

  google,tzpc-smc:
    $ref: /schemas/types.yaml#/definitions/uint32
    description:
      Argument of the secure monitor call that saves and restores the TZPC
      state of the domain around a power cycle. Omit if not needed.

required:
  - compatible
  - "#power-domain-cells"
  - google,pmu-syscon
  - google,pmu-offset

unevaluatedProperties: false

examples:
  - |
    power-domain@27f00800 {
        compatible = "google,gs201-power-domain";
        reg = <0x27f00800 0x4>;
        #power-domain-cells = <0>;
        google,pmu-syscon = <&pmu_system_controller>;
        google,pmu-offset = <0x1e00>;
        google,tzpc-smc = <0x27f10204>;
    };

    power-domain-cores {
        compatible = "google,gs201-power-domain";
        #power-domain-cells = <0>;
        power-domains = <&pd_top>;
        google,pmu-syscon = <&pmu_system_controller>;
        google,pmu-offset = <0x2000>;
    };
```

## Documentation/devicetree/bindings/power/supply/maxim,max17201.yaml
```yaml
# SPDX-License-Identifier: GPL-2.0-only OR BSD-2-Clause
%YAML 1.2
---
$id: http://devicetree.org/schemas/power/supply/maxim,max17201.yaml#
$schema: http://devicetree.org/meta-schemas/core.yaml#

title: Maxim MAX17201 fuel gauge

maintainers:
  - Dimitri Fedrau <dima.fedrau@gmail.com>

allOf:
  - $ref: power-supply.yaml#
  - if:
      properties:
        compatible:
          const: maxim,max77759
    then:
      properties:
        reg:
          maxItems: 1
      required:
        - maxim,rsense-micro-ohms
    else:
      required:
        - reg-names

properties:
  compatible:
    oneOf:
      - const: maxim,max17201
      - items:
          - enum:
              - maxim,max17205
          - const: maxim,max17201
      - const: maxim,max77759

  reg:
    items:
      - description: ModelGauge m5 registers
      - description: Nonvolatile registers

  reg-names:
    items:
      - const: m5
      - const: nvmem

  interrupts:
    maxItems: 1

  maxim,rsense-micro-ohms:
    description:
      Sense resistor value in micro-ohms. Only meaningful on devices
      without I2C-reachable nonvolatile memory (like the MAX77759), where
      the calibrated value cannot be read from the gauge.

required:
  - compatible
  - reg

unevaluatedProperties: false

examples:
  - |
    #include <dt-bindings/interrupt-controller/irq.h>
    i2c {
      #address-cells = <1>;
      #size-cells = <0>;

      fuel-gauge@36 {
        compatible = "maxim,max17201";
        reg = <0x36>, <0xb>;
        reg-names = "m5", "nvmem";
        interrupt-parent = <&gpio0>;
        interrupts = <31 IRQ_TYPE_LEVEL_LOW>;
      };

      fuel-gauge@36 {
        compatible = "maxim,max77759";
        reg = <0x36>;
        maxim,rsense-micro-ohms = <5000>;
      };
    };
```

## arch/arm64/Kconfig.debug
```kconfig
# SPDX-License-Identifier: GPL-2.0-only

config PID_IN_CONTEXTIDR
	bool "Write the current PID to the CONTEXTIDR register"
	help
	  Enabling this option causes the kernel to write the current PID to
	  the CONTEXTIDR register, at the expense of some additional
	  instructions during context switch. Say Y here only if you are
	  planning to use hardware trace tools with this kernel.

config DEBUG_EFI
	depends on EFI && DEBUG_INFO
	bool "UEFI debugging"
	help
	  Enable this option to include EFI specific debugging features into
	  the kernel that are only useful when using a debug build of the
	  UEFI firmware

config ARM64_RELOC_TEST
	depends on m
	tristate "Relocation testing module"

source "drivers/hwtracing/coresight/Kconfig"

config GS201_BRINGUP
	bool "Pixel 7a (gs201) bring-up hacks (do not upstream)"
	depends on ARCH_EXYNOS
	select LIBFDT
	help
	  Logs the boot console into the ramoops console zone and replaces
	  the bootloader devicetree with the built-in gs201-lynx one, keeping
	  the bootloader's /memory, /chosen and /reserved-memory.

config GS201_BRINGUP_TEST_RESET
	bool "Reset via PSCI right after the earliest bring-up markers"
	depends on GS201_BRINGUP

config GS201_BRINGUP_DISARM_WDT
	bool "Write WTCON=0 to the cluster watchdogs at the very start"
	depends on GS201_BRINGUP
```

## drivers/gpu/drm/gs201/Kconfig
```kconfig
# SPDX-License-Identifier: GPL-2.0-only
config DRM_GS201_DPU
	tristate "Google Tensor GS201 display controller (DECON/DPP)"
	depends on DRM && OF && (ARCH_EXYNOS || COMPILE_TEST)
	select DRM_CLIENT_SELECTION
	select DRM_GEM_DMA_HELPER
	select DRM_KMS_HELPER
	help
	  Display controller driver for the Google Tensor G2 (GS201), as found
	  in the Pixel 7 and 7a. Initially this adopts the DECON/DPP/DSIM
	  pipeline and command-mode panel left running by the bootloader,
	  scanning out a single XRGB8888 plane with frame-done driven page
	  flips.

config DRM_GS201_DSIM
	tristate "Google Tensor GS201 MIPI DSI host"
	depends on DRM && OF && (ARCH_EXYNOS || COMPILE_TEST)
	select DRM_MIPI_DSI
	select DRM_PANEL_BRIDGE
	help
	  MIPI DSI host controller (DSIM) of the Google Tensor G2. This stage
	  adopts the link, clocks and D-PHY configured by the bootloader and
	  only provides the command FIFO interface to the panel, which the
	  panel driver uses for brightness and display on/off.
```

## drivers/pmdomain/samsung/Kconfig
```kconfig
# SPDX-License-Identifier: GPL-2.0
if SOC_SAMSUNG

config EXYNOS_PM_DOMAINS
	bool "Exynos PM domains" if COMPILE_TEST
	depends on (ARCH_EXYNOS && PM_GENERIC_DOMAINS) || COMPILE_TEST

config GS201_PM_DOMAINS
	bool "Google Tensor GS201 PM domains"
	depends on (ARCH_EXYNOS && PM_GENERIC_DOMAINS && OF) || COMPILE_TEST
	select MFD_SYSCON
	help
	  Support for the PMU controlled power domains of the Google Tensor G2
	  (GS201), such as the GPU domains. The domains are switched through
	  the PMU configuration and status registers, following the vendor
	  power-on and power-off sequences.

endif
```
