## Documentation/devicetree/bindings/clock/google,gs201-clock.yaml
```yaml
# SPDX-License-Identifier: (GPL-2.0-only OR BSD-2-Clause)
%YAML 1.2
---
$id: http://devicetree.org/schemas/clock/google,gs201-clock.yaml#
$schema: http://devicetree.org/meta-schemas/core.yaml#

title: Google GS201 clock controllers

maintainers:
  - Theo Paris <theo@theoparis.com>

description: |
  Google GS201 has separate clock management units (CMUs). CMU_TOP
  generates clocks for the other CMUs using PLLs, multiplexers, dividers,
  and gates. Its external reference clock is supplied by the board; on
  Pixel 7a this is 24.576 MHz.

  CMU_TOP also has an alternative boost input from CMU_APM. The boost
  input may be specified when that provider is available. Without it,
  boost multiplexers must remain on their CMU_TOP-derived inputs.

  CMU_MISC supplies system peripherals, including the watchdogs and MCT.
  CMU_PERIC0 and CMU_PERIC1 supply connectivity peripherals such as USI
  and I3C controllers. CMU_HSI0 supplies USB and DisplayPort PHY clocks.
  These CMUs use the external reference and clocks generated by CMU_TOP.

  Clock identifiers are defined in dt-bindings/clock/google,gs201.h.
  CMU_HSI2 supplies the UFS, PCIe and MMC interfaces. CMU_DPU supplies the
  display frontend including DPP; CMU_DISP supplies the DECON backend.
  These three CMUs have switchable power domains. Their clock providers
  require the associated domain to be powered before register access.
  CMU_HSI0 also has a switchable power domain with the same requirement.
  Its USB reference path is derived from the HSI0 USB PLL and divider;
  alternate, PHY-output and TCXO inputs remain unverified.

  CMU_APM is not described yet.

properties:
  compatible:
    enum:
      - google,gs201-cmu-top
      - google,gs201-cmu-misc
      - google,gs201-cmu-peric0
      - google,gs201-cmu-peric1
      - google,gs201-cmu-hsi2
      - google,gs201-cmu-dpu
      - google,gs201-cmu-disp
      - google,gs201-cmu-hsi0

  reg:
    maxItems: 1

  "#clock-cells":
    const: 1

  clocks:
    minItems: 1
    maxItems: 5

  clock-names:
    minItems: 1
    maxItems: 5

  power-domains:
    maxItems: 1

required:
  - compatible
  - reg
  - "#clock-cells"
  - clocks
  - clock-names

allOf:
  - if:
      properties:
        compatible:
          const: google,gs201-cmu-top
    then:
      properties:
        clocks:
          minItems: 1
          items:
            - description: External reference clock
            - description: Alternative boost clock from CMU_APM
        clock-names:
          minItems: 1
          items:
            - const: oscclk
            - const: boost

  - if:
      properties:
        compatible:
          const: google,gs201-cmu-misc
    then:
      properties:
        clocks:
          items:
            - description: External reference clock
            - description: MISC NoC bus clock from CMU_TOP
            - description: MISC security subsystem clock from CMU_TOP
        clock-names:
          items:
            - const: oscclk
            - const: bus
            - const: sss

  - if:
      properties:
        compatible:
          enum:
            - google,gs201-cmu-peric0
            - google,gs201-cmu-peric1
    then:
      properties:
        clocks:
          items:
            - description: External reference clock
            - description: PERIC NoC bus clock from CMU_TOP
            - description: PERIC IP clock from CMU_TOP
        clock-names:
          items:
            - const: oscclk
            - const: bus
            - const: ip

  - if:
      properties:
        compatible:
          const: google,gs201-cmu-hsi2
    then:
      properties:
        clocks:
          items:
            - description: External reference clock
            - description: HSI2 NoC bus clock from CMU_TOP
            - description: HSI2 PCIe clock from CMU_TOP
            - description: HSI2 UFS clock from CMU_TOP
            - description: HSI2 MMC clock from CMU_TOP
        clock-names:
          items:
            - const: oscclk
            - const: bus
            - const: pcie
            - const: ufs
            - const: mmc

  - if:
      properties:
        compatible:
          const: google,gs201-cmu-hsi0
    then:
      properties:
        clocks:
          items:
            - description: External reference clock
            - description: HSI0 NoC bus clock from CMU_TOP
            - description: HSI0 DisplayPort TC clock from CMU_TOP
            - description: HSI0 USB DRD clock from CMU_TOP
            - description: HSI0 USBDP debug clock from CMU_TOP
        clock-names:
          items:
            - const: oscclk
            - const: bus
            - const: dpgtc
            - const: usb31drd
            - const: usbdpdbg

  - if:
      properties:
        compatible:
          enum:
            - google,gs201-cmu-dpu
            - google,gs201-cmu-disp
    then:
      properties:
        clocks:
          items:
            - description: External reference clock
            - description: Display NoC bus clock from CMU_TOP
        clock-names:
          items:
            - const: oscclk
            - const: bus

  - if:
      properties:
        compatible:
          not:
            enum:
              - google,gs201-cmu-hsi2
              - google,gs201-cmu-dpu
              - google,gs201-cmu-disp
              - google,gs201-cmu-hsi0
    then:
      properties:
        power-domains: false

additionalProperties: false

examples:
  - |
    #include <dt-bindings/clock/google,gs201.h>

    cmu_top: clock-controller@1e080000 {
        compatible = "google,gs201-cmu-top";
        reg = <0x1e080000 0x8000>;
        #clock-cells = <1>;
        clocks = <&ext_24_5m>;
        clock-names = "oscclk";
    };

    cmu_peric0: clock-controller@10800000 {
        compatible = "google,gs201-cmu-peric0";
        reg = <0x10800000 0x8000>;
        #clock-cells = <1>;
        clocks = <&ext_24_5m>,
                 <&cmu_top CLK_GOUT_CMU_PERIC0_NOC>,
                 <&cmu_top CLK_GOUT_CMU_PERIC0_IP>;
        clock-names = "oscclk", "bus", "ip";
    };
...
```

## Documentation/devicetree/bindings/display/google,gs201-dpu.yaml
```yaml
# SPDX-License-Identifier: GPL-2.0-only OR BSD-2-Clause
%YAML 1.2
---
$id: http://devicetree.org/schemas/display/google,gs201-dpu.yaml#
$schema: http://devicetree.org/meta-schemas/core.yaml#

title: Google GS201 display processing unit

maintainers:
  - Theo Paris <theo@theoparis.com>

description: |
  Display controller of the Google Tensor G2 (GS201). The frontend (DPU
  in the CMU naming) contains the DMA and DPP layer channels, the backend
  (DISP) contains the DECON timing generator that feeds the DSI hosts.
  Each part is clocked from its own CMU.

properties:
  compatible:
    const: google,gs201-dpu

  reg:
    items:
      - description: DECON main registers
      - description: DPU DMA channel registers

  reg-names:
    items:
      - const: decon
      - const: dpp

  clocks:
    items:
      - description: DPU frontend DMA bus clock
      - description: DPU frontend DPP bus clock
      - description: DPU frontend register bridge clock
      - description: DISP backend DECON bus clock
      - description: DISP backend register bridge clock

  clock-names:
    items:
      - const: dma
      - const: dpp
      - const: dpu-apb
      - const: decon
      - const: disp-apb

  interrupts:
    items:
      - description: DECON frame start
      - description: DECON frame done
      - description: DECON extra events (TE, time-out, resource conflict)

  interrupt-names:
    items:
      - const: frame_start
      - const: frame_done
      - const: extra

  port:
    $ref: /schemas/graph.yaml#/properties/port
    description: Output to the DSI host.

required:
  - compatible
  - reg
  - reg-names
  - clocks
  - clock-names
  - interrupts
  - interrupt-names
  - port

additionalProperties: false

examples:
  - |
    #include <dt-bindings/clock/google,gs201.h>
    #include <dt-bindings/interrupt-controller/arm-gic.h>

    display-controller@1c240000 {
        compatible = "google,gs201-dpu";
        reg = <0x1c240000 0x6000>, <0x1c0b0000 0x6000>;
        reg-names = "decon", "dpp";
        clocks = <&cmu_dpu CLK_GOUT_DPU_DPUF_ACLK_DMA>,
                 <&cmu_dpu CLK_GOUT_DPU_DPUF_ACLK_DPP>,
                 <&cmu_dpu CLK_GOUT_DPU_AD_APB_DPU_DMA_PCLKM>,
                 <&cmu_disp CLK_GOUT_DISP_DPUB_ACLK_DECON>,
                 <&cmu_disp CLK_GOUT_DISP_AD_APB_DECON_MAIN_PCLKM>;
        clock-names = "dma", "dpp", "dpu-apb", "decon", "disp-apb";
        interrupts = <GIC_SPI 241 IRQ_TYPE_LEVEL_HIGH 0>,
                     <GIC_SPI 240 IRQ_TYPE_LEVEL_HIGH 0>,
                     <GIC_SPI 239 IRQ_TYPE_LEVEL_HIGH 0>;
        interrupt-names = "frame_start", "frame_done", "extra";

        port {
            endpoint {
                remote-endpoint = <&dsim0_in>;
            };
        };
    };
```

## Documentation/devicetree/bindings/display/google,gs201-dsim.yaml
```yaml
# SPDX-License-Identifier: GPL-2.0-only OR BSD-2-Clause
%YAML 1.2
---
$id: http://devicetree.org/schemas/display/google,gs201-dsim.yaml#
$schema: http://devicetree.org/meta-schemas/core.yaml#

title: Google GS201 MIPI DSI host

maintainers:
  - Theo Paris <theo@theoparis.com>

description: |
  Samsung DSIM based MIPI DSI host of the Google Tensor G2 (GS201). It sits
  in the DISP block next to the DECON and shares the DISP backend clock.

allOf:
  - $ref: /schemas/display/dsi-controller.yaml#

properties:
  compatible:
    const: google,gs201-dsim

  reg:
    maxItems: 1

  clocks:
    items:
      - description: DISP backend bus clock

  clock-names:
    items:
      - const: bus

  ports:
    $ref: /schemas/graph.yaml#/properties/ports

    properties:
      port@0:
        $ref: /schemas/graph.yaml#/properties/port
        description: Input from the DECON.

    required:
      - port@0

required:
  - compatible
  - reg
  - clocks
  - clock-names
  - ports

unevaluatedProperties: false

examples:
  - |
    #include <dt-bindings/clock/google,gs201.h>

    dsi@1c2c0000 {
        compatible = "google,gs201-dsim";
        reg = <0x1c2c0000 0x300>;
        clocks = <&cmu_disp CLK_GOUT_DISP_DPUB_ACLK_DECON>;
        clock-names = "bus";
        #address-cells = <1>;
        #size-cells = <0>;

        ports {
            #address-cells = <1>;
            #size-cells = <0>;

            port@0 {
                reg = <0>;
                dsim0_in: endpoint {
                    remote-endpoint = <&dpu_out>;
                };
            };
        };

        panel@0 {
            compatible = "samsung,s6e3fc5";
            reg = <0>;
        };
    };
```

## Documentation/devicetree/bindings/display/panel/samsung,s6e3fc5.yaml
```yaml
# SPDX-License-Identifier: GPL-2.0-only OR BSD-2-Clause
%YAML 1.2
---
$id: http://devicetree.org/schemas/display/panel/samsung,s6e3fc5.yaml#
$schema: http://devicetree.org/meta-schemas/core.yaml#

title: Samsung S6E3FC5 AMOLED DSI panel

maintainers:
  - Theo Paris <theo@theoparis.com>

description: |
  1080x2400 command-mode DSI AMOLED panel with display stream compression,
  used in the Google Pixel 7a.

allOf:
  - $ref: panel-common.yaml#

properties:
  compatible:
    const: samsung,s6e3fc5

  reg:
    maxItems: 1

  vci-supply:
    description: Panel analog supply

  vddi-supply:
    description: Panel interface supply

required:
  - compatible
  - reg

unevaluatedProperties: false

examples:
  - |
    #include <dt-bindings/gpio/gpio.h>

    dsi {
        #address-cells = <1>;
        #size-cells = <0>;

        panel@0 {
            compatible = "samsung,s6e3fc5";
            reg = <0>;
            reset-gpios = <&gpa7 1 GPIO_ACTIVE_LOW>;
            vci-supply = <&vci_reg>;
            vddi-supply = <&vddi_reg>;
        };
    };
```

## Documentation/devicetree/bindings/mfd/samsung,s2mpg12-pmic.yaml
```yaml
# SPDX-License-Identifier: GPL-2.0-only OR BSD-2-Clause
%YAML 1.2
---
$id: http://devicetree.org/schemas/mfd/samsung,s2mpg12-pmic.yaml#
$schema: http://devicetree.org/meta-schemas/core.yaml#

title: Samsung S2MPG12 Power Management IC

maintainers:
  - Theo Paris <theo@theoparis.com>

description: |
  This is part of the device tree bindings for the S2MPG12 Power Management IC
  (PMIC).

  The Samsung S2MPG12 is a Power Management IC for mobile applications with buck
  converters, various LDOs, power meters, RTC and additional GPIO interfaces and
  is typically complemented by a S2MPG13 PMIC in a main/sub configuration as the
  main PMIC.

properties:
  compatible:
    const: samsung,s2mpg12-pmic

  interrupts:
    maxItems: 1

  regulators:
    type: object
    $ref: /schemas/regulator/samsung,s2mpg12-regulator.yaml
    description:
      List of child nodes that specify the regulators.

  wakeup-source: true

required:
  - compatible
  - interrupts
  - regulators

additionalProperties: false

examples:
  - |
    #include <dt-bindings/gpio/gpio.h>
    #include <dt-bindings/interrupt-controller/irq.h>

    pmic {
        compatible = "samsung,s2mpg12-pmic";
        interrupts-extended = <&gpa0 6 IRQ_TYPE_LEVEL_LOW>;
        pinctrl-names = "default";
        pinctrl-0 = <&pmic_int>;
        wakeup-source;

        regulators {
            buck1m {
                regulator-name = "vdd_mif";
                regulator-min-microvolt = <450000>;
                regulator-max-microvolt = <1300000>;
                regulator-ramp-delay = <6250>;
            };

            ldo1m {
                regulator-name = "vdd_alive";
                regulator-min-microvolt = <450000>;
                regulator-max-microvolt = <950000>;
                regulator-always-on;
            };

            ldo27m {
                regulator-name = "vdd_disp_vci";
                regulator-min-microvolt = <3025000>;
                regulator-max-microvolt = <3025000>;
            };
        };
    };
```
